/* Copyright (C) iSOFT (2020), iSOFT INFRASTRUCTURE SOFTWARE CO.,LTD.
* All rights reserved. This software is iSOFT property. Duplication
* or disclosure without iSOFT written authorization is prohibited.
* @file <XCPsim.a2l>
* @brief <>
* <MCU:TC377>
* @author <>
* @date <2023-03-23 10:59:35>
*/ ASAP2_VERSION 1 60
/begin PROJECT CanApe_test ""
/begin MODULE CPP ""
/begin MOD_COMMON "" BYTE_ORDER MSB_LAST ALIGNMENT_BYTE 1 ALIGNMENT_WORD 1 ALIGNMENT_LONG 1 ALIGNMENT_INT64 1 ALIGNMENT_FLOAT32_IEEE 1 ALIGNMENT_FLOAT64_IEEE 1 /end MOD_COMMON
/begin IF_DATA XCP
 /begin PROTOCOL_LAYER 0x0100 0x0FA0 0x2710 0x00 0x00 0x00 0x00 0x00 0x8 /* MAX_CTO */ 0x8 /* MAX_DTO */ BYTE_ORDER_MSB_FIRST ADDRESS_GRANULARITY_BYTE OPTIONAL_CMD PROGRAM_RESET OPTIONAL_CMD PROGRAM OPTIONAL_CMD PROGRAM_CLEAR OPTIONAL_CMD PROGRAM_START OPTIONAL_CMD ALLOC_ODT_ENTRY OPTIONAL_CMD ALLOC_ODT OPTIONAL_CMD ALLOC_DAQ OPTIONAL_CMD FREE_DAQ OPTIONAL_CMD START_STOP_SYNCH OPTIONAL_CMD START_STOP_DAQ_LIST OPTIONAL_CMD WRITE_DAQ OPTIONAL_CMD SET_DAQ_PTR OPTIONAL_CMD CLEAR_DAQ_LIST OPTIONAL_CMD DOWNLOAD OPTIONAL_CMD BUILD_CHECKSUM OPTIONAL_CMD SET_DAQ_LIST_MODE OPTIONAL_CMD GET_COMM_MODE_INFO OPTIONAL_CMD GET_ID OPTIONAL_CMD SET_MTA OPTIONAL_CMD UPLOAD OPTIONAL_CMD SHORT_UPLOAD OPTIONAL_CMD BUILD_CHECKSUM OPTIONAL_CMD TRANSPORT_LAYER_CMD OPTIONAL_CMD GET_SEED OPTIONAL_CMD UNLOCK OPTIONAL_CMD DOWNLOAD_NEXT OPTIONAL_CMD DOWNLOAD_MAX OPTIONAL_CMD SHORT_DOWNLOAD OPTIONAL_CMD MODIFY_BITS OPTIONAL_CMD SET_CAL_PAGE OPTIONAL_CMD GET_CAL_PAGE OPTIONAL_CMD READ_DAQ OPTIONAL_CMD GET_DAQ_CLOCK OPTIONAL_CMD GET_DAQ_PROCESSOR_INFO OPTIONAL_CMD GET_DAQ_RESOLUTION_INFO OPTIONAL_CMD GET_DAQ_LIST_MODE OPTIONAL_CMD GET_DAQ_EVENT_INFO OPTIONAL_CMD GET_DAQ_LIST_INFO COMMUNICATION_MODE_SUPPORTED BLOCK SLAVE MASTER 0x8 0xa SEED_AND_KEY_EXTERNAL_FUNCTION "seedkey.dll" /end PROTOCOL_LAYER
 /begin DAQ DYNAMIC /* DAQ_CONFIG_TYPE */ 0x1 /* MAX_DAQ */ 0x1 /* MAX_EVENT_CHANNEL */ 0x0 /* MIN_DAQ */ OPTIMISATION_TYPE_DEFAULT ADDRESS_EXTENSION_FREE IDENTIFICATION_FIELD_TYPE_ABSOLUTE GRANULARITY_ODT_ENTRY_SIZE_DAQ_BYTE 0x7 /* MAX_ODT_ENTRY_SIZE_DAQ */ NO_OVERLOAD_INDICATION
  /begin TIMESTAMP_SUPPORTED 0x0 /* TIMESTAMP_TICKS */ SIZE_BYTE /* TIMESTAMP_SIZE */ UNIT_100MS /* RESOLUTION OF TIMESTAMP */ /end TIMESTAMP_SUPPORTED
  /begin DAQ_LIST 0x0 /* DAQ_LIST_NUMBER */ DAQ_LIST_TYPE DAQ MAX_ODT 0x91 MAX_ODT_ENTRIES 0x7 FIRST_PID 0x0 /end DAQ_LIST
  /begin EVENT "Xcp_Evch_0" /* EVENT_CHANNEL_NAME */ "EvCh0" /* EVENT_CHANNEL_SHORT_NAME */ 0x0 /* EVENT_CHANNEL_NUMBER */ DAQ /* DIRECTION */ 0x1 /* MAX_DAQ_LIST */ 0x64 /* EVENT_CHANNEL_TIME_CYCLE */ 0x6 /* EVENT_CHANNEL_TIME_UNIT */ 0x1 /* EVENT_CHANNEL_PRIORITY */ /end EVENT
 /end DAQ
 /begin PAG 0x01 /* MAX_SEGMENTS */ /end PAG
 /begin PGM PGM_MODE_ABSOLUTE 0x1 /* MAX_SECTORS */ 0x8 /* MAX_CTO_PGM */ COMMUNICATION_MODE_SUPPORTED BLOCK SLAVE MASTER 0x16 0xa /end PGM
 /begin XCP_ON_CAN 0x0101 /* XCP on CAN 1.1 */ CAN_ID_MASTER 0x601 /* CMD/STIM */ CAN_ID_SLAVE 0x60f /* RES/ERR/EV/SERV/DAQ */ BAUDRATE 0x07A120 /* BAUDRATE */ SAMPLE_POINT 0x4B SAMPLE_RATE SINGLE BTL_CYCLES 0x08 SJW 0x02 SYNC_EDGE SINGLE MAX_DLC_REQUIRED /end XCP_ON_CAN
/end IF_DATA
/begin MOD_PAR ""
 /begin MEMORY_SEGMENT CALRAM "" DATA RAM INTERN 0x60028800 0x10000 -1 -1 -1 -1 -1
  /begin IF_DATA XCP
   /begin SEGMENT 0x00 /* SEGMENT_NUMBER */ 0x01 /* number of pages */ 0x00 /* ADDRESS_EXTENSION */ 0x00 /* COMPRESSION_METHOD */ 0x00 /* ENCRYPTION_METHOD */
    /begin CHECKSUM XCP_CRC_16_CITT MAX_BLOCK_SIZE 0xFF EXTERNAL_FUNCTION "chksum.dll" /end CHECKSUM
    /begin PAGE 0x00 ECU_ACCESS_WITH_XCP_ONLY XCP_READ_ACCESS_WITH_ECU_ONLY XCP_WRITE_ACCESS_WITH_ECU_ONLY INIT_SEGMENT 0x00 /end PAGE
    /begin ADDRESS_MAPPING 0x60028800 /* source address */ 0xa02f0000 /* destination address */ 0x10000 /* length */ /end ADDRESS_MAPPING
   /end SEGMENT
  /end IF_DATA
 /end MEMORY_SEGMENT
/end MOD_PAR
/end MODULE
/end PROJECT
